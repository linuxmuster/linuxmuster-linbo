## buildroot-external/Config.in
```kconfig
source "$BR2_EXTERNAL_LINBO_PATH/package/bvi/Config.in"
source "$BR2_EXTERNAL_LINBO_PATH/package/cloop/Config.in"
source "$BR2_EXTERNAL_LINBO_PATH/package/ubuntugrub/Config.in"
source "$BR2_EXTERNAL_LINBO_PATH/package/linbo_gui/Config.in"
source "$BR2_EXTERNAL_LINBO_PATH/package/ms-sys/Config.in"
source "$BR2_EXTERNAL_LINBO_PATH/package/reged/Config.in"
source "$BR2_EXTERNAL_LINBO_PATH/package/reiserfsprogs/Config.in"
```

## buildroot-external/configs/linbo-x86_64_defconfig
```kconfig
BR2_x86_64=y
BR2_TOOLCHAIN_BUILDROOT_GLIBC=y
BR2_TOOLCHAIN_BUILDROOT_CXX=y
BR2_ROOTFS_MERGED_USR=y
BR2_TARGET_GENERIC_HOSTNAME="linbo"
BR2_TARGET_GENERIC_ISSUE=""
BR2_ROOTFS_DEVICE_CREATION_DYNAMIC_EUDEV=y
BR2_ENABLE_LOCALE_WHITELIST=""
BR2_ROOTFS_OVERLAY="$(BR2_EXTERNAL_LINBO_PATH)/board/rootfs_overlay/"
BR2_ROOTFS_POST_BUILD_SCRIPT="$(BR2_EXTERNAL_LINBO_PATH)/board/post_build_clean.sh $(BR2_EXTERNAL_LINBO_PATH)/board/post_build_put.sh"
BR2_ROOTFS_POST_IMAGE_SCRIPT="$(BR2_EXTERNAL_LINBO_PATH)/board/post_image.sh"
BR2_LINUX_KERNEL=y
BR2_LINUX_KERNEL_PATCH="$(BR2_EXTERNAL)/linux-patch"
BR2_LINUX_KERNEL_USE_CUSTOM_CONFIG=y
BR2_LINUX_KERNEL_CUSTOM_CONFIG_FILE="$(BR2_EXTERNAL_LINBO_PATH)/board/linux-x86_64.config"
BR2_LINUX_KERNEL_XZ=y
BR2_PACKAGE_DOSFSTOOLS=y
BR2_PACKAGE_DOSFSTOOLS_FATLABEL=y
BR2_PACKAGE_DOSFSTOOLS_FSCK_FAT=y
BR2_PACKAGE_DOSFSTOOLS_MKFS_FAT=y
BR2_PACKAGE_E2FSPROGS=y
BR2_PACKAGE_E2FSPROGS_RESIZE2FS=y
BR2_PACKAGE_NTFS_3G=y
BR2_PACKAGE_NTFS_3G_NTFSPROGS=y
BR2_PACKAGE_QT5BASE_GUI=y
BR2_PACKAGE_QT5BASE_DEFAULT_QPA="linuxfb"
BR2_PACKAGE_XKEYBOARD_CONFIG=y
BR2_PACKAGE_B43_FIRMWARE=y
BR2_PACKAGE_LINUX_FIRMWARE=y
BR2_PACKAGE_LINUX_FIRMWARE_ATHEROS_6002=y
BR2_PACKAGE_LINUX_FIRMWARE_ATHEROS_6003=y
BR2_PACKAGE_LINUX_FIRMWARE_ATHEROS_6004=y
BR2_PACKAGE_LINUX_FIRMWARE_ATHEROS_7010=y
BR2_PACKAGE_LINUX_FIRMWARE_ATHEROS_9170=y
BR2_PACKAGE_LINUX_FIRMWARE_ATHEROS_9271=y
BR2_PACKAGE_LINUX_FIRMWARE_BRCM_BCM43XX=y
BR2_PACKAGE_LINUX_FIRMWARE_BRCM_BCM43XXX=y
BR2_PACKAGE_LINUX_FIRMWARE_IWLWIFI_3160=y
BR2_PACKAGE_LINUX_FIRMWARE_IWLWIFI_3168=y
BR2_PACKAGE_LINUX_FIRMWARE_IWLWIFI_5000=y
BR2_PACKAGE_LINUX_FIRMWARE_IWLWIFI_6000G2A=y
BR2_PACKAGE_LINUX_FIRMWARE_IWLWIFI_6000G2B=y
BR2_PACKAGE_LINUX_FIRMWARE_IWLWIFI_7260=y
BR2_PACKAGE_LINUX_FIRMWARE_IWLWIFI_7265D=y
BR2_PACKAGE_LINUX_FIRMWARE_IWLWIFI_8000C=y
BR2_PACKAGE_LINUX_FIRMWARE_IWLWIFI_8265=y
BR2_PACKAGE_LINUX_FIRMWARE_LIBERTAS_SD8686_V8=y
BR2_PACKAGE_LINUX_FIRMWARE_LIBERTAS_SD8686_V9=y
BR2_PACKAGE_LINUX_FIRMWARE_LIBERTAS_SD8688=y
BR2_PACKAGE_LINUX_FIRMWARE_MWIFIEX_SD8787=y
BR2_PACKAGE_LINUX_FIRMWARE_MWIFIEX_SD8797=y
BR2_PACKAGE_LINUX_FIRMWARE_MWIFIEX_SD8887=y
BR2_PACKAGE_LINUX_FIRMWARE_MWIFIEX_SD8897=y
BR2_PACKAGE_LINUX_FIRMWARE_MWIFIEX_PCIE8897=y
BR2_PACKAGE_LINUX_FIRMWARE_MEDIATEK_MT7601U=y
BR2_PACKAGE_LINUX_FIRMWARE_QUALCOMM_6174=y
BR2_PACKAGE_LINUX_FIRMWARE_RALINK_RT61=y
BR2_PACKAGE_LINUX_FIRMWARE_RALINK_RT73=y
BR2_PACKAGE_LINUX_FIRMWARE_RALINK_RT2XX=y
BR2_PACKAGE_LINUX_FIRMWARE_RTL_81XX=y
BR2_PACKAGE_LINUX_FIRMWARE_RTL_87XX=y
BR2_PACKAGE_LINUX_FIRMWARE_RTL_88XX=y
BR2_PACKAGE_LINUX_FIRMWARE_TI_WL127X=y
BR2_PACKAGE_LINUX_FIRMWARE_TI_WL128X=y
BR2_PACKAGE_LINUX_FIRMWARE_TI_WL18XX=y
BR2_PACKAGE_LINUX_FIRMWARE_BNX2X=y
BR2_PACKAGE_LINUX_FIRMWARE_CXGB4_T4=y
BR2_PACKAGE_LINUX_FIRMWARE_CXGB4_T5=y
BR2_PACKAGE_LINUX_FIRMWARE_RTL_8169=y
BR2_PACKAGE_UX500_FIRMWARE=y
BR2_PACKAGE_WILC1000_FIRMWARE=y
BR2_PACKAGE_ZD1211_FIRMWARE=y
BR2_PACKAGE_GPTFDISK=y
BR2_PACKAGE_PARTED=y
BR2_PACKAGE_LIBFUSE=y
BR2_PACKAGE_LIBINPUT=y
BR2_PACKAGE_LIBXKBCOMMON=y
BR2_PACKAGE_PCRE2=y
BR2_PACKAGE_PCRE2_16=y
BR2_PACKAGE_BC=y
BR2_PACKAGE_CTORRENT=y
BR2_PACKAGE_DROPBEAR=y
BR2_PACKAGE_ETHTOOL=y
BR2_PACKAGE_RSYNC=y
BR2_PACKAGE_UDPCAST=y
BR2_PACKAGE_UDPCAST_RECEIVER=y
BR2_PACKAGE_ACL=y
BR2_PACKAGE_EFIBOOTMGR=y
BR2_PACKAGE_UTIL_LINUX_BINARIES=y
BR2_PACKAGE_UTIL_LINUX_MOUNT=y
BR2_TARGET_ROOTFS_CPIO=y
# BR2_TARGET_ROOTFS_TAR is not set
BR2_PACKAGE_BVI=y
BR2_PACKAGE_CLOOP=y
BR2_PACKAGE_GRUB2BIOS=y
BR2_PACKAGE_HOST_GRUB2BIOS=y
BR2_PACKAGE_GRUB2EFI32=y
BR2_PACKAGE_HOST_GRUB2EFI32=y
BR2_PACKAGE_GRUB2EFI64=y
BR2_PACKAGE_HOST_GRUB2EFI64=y
BR2_PACKAGE_LINBO_GUI=y
BR2_PACKAGE_MS_SYS=y
BR2_PACKAGE_REGED=y
BR2_PACKAGE_REISERFSPROGS=y
```

## buildroot-external/package/bvi/Config.in
```kconfig
config BR2_PACKAGE_BVI
    bool "bvi"
    select BR2_PACKAGE_NCURSES
    help
      This package contains bvi.

        http://bvi.sourceforge.net/
```

## buildroot-external/package/cloop/Config.in
```kconfig
config BR2_PACKAGE_CLOOP
	bool "cloop"
	depends on BR2_LINUX_KERNEL
	help
      Cloop module and utils

      http://knoppix.net/wiki3/index.php?title=Cloop
```

## buildroot-external/package/efibootmgr/Config.in
```kconfig
config BR2_PACKAGE_EFIBOOTMGR
    bool "efibootmgr"
    depends on BR2_PACKAGE_EFIVAR
    help
      A Linux user-space application to modify the Intel Extensible
      Firmware Interface (EFI) Boot Manager. This application can create
      and destroy boot entries, change the boot order, change the next
      running boot option, and more.

      https://github.com/rhinstaller/efibootmgr
```

## buildroot-external/package/efivar/Config.in
```kconfig
config BR2_PACKAGE_EFIVAR
    bool "efivar"
    depends on BR2_TOOLCHAIN_HEADERS_AT_LEAST_3_12 # linux/nvme.h
    select BR2_PACKAGE_POPT
    help
      Tools and libraries to manipulate EFI variables

      https://github.com/rhinstaller/efivar

    comment "efivar requires a toolchain w/ headers >= 3.12"
    depends on !BR2_TOOLCHAIN_HEADERS_AT_LEAST_3_12
```

## buildroot-external/package/grub2bios/Config.in
```kconfig
config BR2_PACKAGE_GRUB2BIOS
    bool "grub2bios"
    help
      This package contains GRUB2 for BIOS targets.

      https://www.gnu.org/software/grub/

config BR2_PACKAGE_HOST_GRUB2BIOS
    bool "host-grub2bios"
    help
      This package contains GRUB2 for BIOS build hosts.

      https://www.gnu.org/software/grub/
```

## buildroot-external/package/grub2efi32/Config.in
```kconfig
config BR2_PACKAGE_GRUB2EFI32
    bool "grub2efi32"
    help
      This package contains GRUB2 for 32-bit EFI targets.

      https://www.gnu.org/software/grub/

config BR2_PACKAGE_HOST_GRUB2EFI32
    bool "host-grub2efi32"
    help
      This package contains GRUB2 for 32-bit EFI build hosts.

      https://www.gnu.org/software/grub/
```

## buildroot-external/package/grub2efi64/Config.in
```kconfig
config BR2_PACKAGE_GRUB2EFI64
    bool "grub2efi64"
    help
      This package contains GRUB2 for 64-bit EFI targets.

        https://www.gnu.org/software/grub/

config BR2_PACKAGE_HOST_GRUB2EFI64
    bool "host-grub2efi64"
    help
      This package contains GRUB2 for 64-bit EFI build hosts.

        https://www.gnu.org/software/grub/
```

## buildroot-external/package/linbo/Config.in
```kconfig
config BR2_PACKAGE_LINBO
    bool "linbo"
    select BR2_PACKAGE_RSYNC
    help
      This package contains LINBO-specific programs.

      https://github.com/linuxmuster/linuxmuster-linbo
```

## buildroot-external/package/linbo_gui/Config.in
```kconfig
config BR2_PACKAGE_LINBO_GUI
    bool "linbo_gui"
    depends on BR2_PACKAGE_LINBO
    select BR2_PACKAGE_QT5
    select BR2_PACKAGE_QT5BASE
    select BR2_PACKAGE_QTBASE_GUI
    select BR2_PACKAGE_QT5BASE_WIDGETS
    select BR2_PACKAGE_QT5BASE_PNG
    help
      This package contains the LINBO gui.

      https://github.com/linuxmuster/linuxmuster-linbo/linbo_gui
```

## buildroot-external/package/ms-sys/Config.in
```kconfig
config BR2_PACKAGE_MS_SYS
    bool "ms-sys"
    help
      This package contains ms-sys, a Linux program for writing Microsoft compatible boot records.

      http://ms-sys.sourceforge.net/
```

## buildroot-external/package/musl-obstack/Config.in
```kconfig
config BR2_PACKAGE_MUSL_OBSTACK
    bool "musl-obstack"
    help
      The musl-obstack package is a copy + paste of the obstack functions
      and macros found in GNU gcc libiberty library for use with musl libc.

      https://github.com/pullmoll/musl-obstack
```

## buildroot-external/package/reged/Config.in
```kconfig
config BR2_PACKAGE_REGED
    bool "reged"
    help
      This package contains reged, a simple registry edit utility for Windows registry hives.

      http://pogostick.net/~pnh/ntpasswd
```

## buildroot-external/package/reiserfsprogs/Config.in
```kconfig
config BR2_PACKAGE_REISERFSPROGS
    bool "reiserfsprogs"
    select BR2_PACKAGE_UTIL_LINUX_LIBUUID
    help
      This package contains reiserfsprogs.

        https://www.kernel.org/
```

## buildroot-external/package/ubuntugrub/Config.in
```kconfig
config BR2_PACKAGE_UBUNTUGRUB
    bool "ubuntugrub"
    help
      This package contains bionic GRUB2 for BIOS, EFI32 and EFI64 targets.

      https://www.gnu.org/software/grub/

config BR2_PACKAGE_HOST_UBUNTUGRUB
    bool "host-ubuntugrub"
    help
      This package contains GRUB2 for BIOS, EFI32 and EFI64 build hosts.

      https://www.gnu.org/software/grub/
```
